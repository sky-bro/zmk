## app/dts/bindings/behaviors/zmk,behavior-report.yaml
```yaml
# Copyright (c) 2020 The ZMK Contributors
# SPDX-License-Identifier: MIT

description: Keyboard Report Behavior, to report (type out) things about the keyboard

compatible: "zmk,behavior-report"

include: zero_param.yaml

properties:
  # report type, default is 0
  type:
    type: int
    required: false
    default: 0
```
